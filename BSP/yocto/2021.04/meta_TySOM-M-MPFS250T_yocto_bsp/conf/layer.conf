## BSP/yocto/2021.04/meta_TySOM-M-MPFS250T_yocto_bsp/conf/layer.conf
```bitbake
# We have a conf and classes directory, add to BBPATH
BBPATH .= ":${LAYERDIR}"

# We have a packages directory, add to BBFILES
BBFILES += "${LAYERDIR}/recipes-*/*/*.bb"
BBFILES += "${LAYERDIR}/recipes-*/*/*.bbappend"

BBFILE_COLLECTIONS += "meta_TySOM-M-MPFS250T_yocto_bsp"
BBFILE_PATTERN_meta_TySOM-M-MPFS250T_yocto_bsp = "^${LAYERDIR}/"
BBFILE_PRIORITY_meta_TySOM-M-MPFS250T_yocto_bsp = "5"

LAYERDEPENDS_meta_TySOM-M-MPFS250T_yocto_bsp = "core"
LAYERDEPENDS_meta_TySOM-M-MPFS250T_yocto_bsp = "meta-polarfire-soc-yocto-bsp"
LAYERSERIES_COMPAT_meta_TySOM-M-MPFS250T_yocto_bsp = "gatesgarth hardknott"
```
