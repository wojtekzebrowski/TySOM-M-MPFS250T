## BSP/yocto/2021.08/meta_TySOM-M-MPFS250T_yocto_bsp/conf/machine/tysom-m-mpfs250t.conf
```bitbake
#@TYPE: Machine
#@NAME: TySOM-M-MPFS250T
#@DESCRIPTION: Machine support for TySOM-M-MPFS250T Evaluation Board.
#
# For details on the Evaluation board:
#     https://www.aldec.com/en/products/emulation/tysom_boards
#

require conf/machine/include/riscv/tune-riscv.inc

MACHINE_FEATURES = "screen keyboard ext2 ext3 serial"

KERNEL_CLASSES = "kernel-fitimage"
KERNEL_IMAGETYPE = "fitImage"

RISCV_SBI_FDT ?=  "aldec-tysom-m-mpfs250t.dtb"
KERNEL_DEVICETREE ?= "aldec/${RISCV_SBI_FDT}"

PREFERRED_PROVIDER_virtual/kernel ?= "mpfs-linux"

PREFERRED_VERSION_openocd-native = "riscv"
PREFERRED_VERSION_openocd = "riscv"

EXTRA_IMAGEDEPENDS += " hss"

UBOOT_MACHINE="aldec_tysom_m_mpfs250t_defconfig"
PREFERRED_PROVIDER_virtual/bootloader = "u-boot-mpfs"
UBOOT_DEVICE_TREE ?= "tysom-m-mpfs250t.dtb"
UBOOT_ENTRYPOINT = "0x80200000"
UBOOT_DTB_LOADADDRESS = "0x82200000"


## Set this to "mmc-tftp" to generate a boot.scr file which should be included
##  in the boot partition. It will try to load a kernel image from mmc and fall back to tftp
UBOOT_ENV = "mmc-tftp"

HSS_PAYLOAD = "uboot"

SERIAL_CONSOLES = "115200;ttySIF0"

MACHINE_EXTRA_RRECOMMENDS += " kernel-modules"

IMAGE_FSTYPES += "wic wic.gz ext4"

## Do not update fstab file when using wic images
WIC_CREATE_EXTRA_ARGS ?= "--no-fstab-update"

## wic default support
WKS_FILE_DEPENDS ?= " \
    hss \
    e2fsprogs-native \
    bmap-tools-native \
"

IMAGE_BOOT_FILES ?= " \
    fitImage \
    boot.scr.uimg \
"

WKS_FILE ?= "mpfs-icicle-kit.wks"

CORE_IMAGE_EXTRA_INSTALL += " phytool board-tests can-sender can-listener canutils iproute2 devmem2 memtester python3-smbus2 can-fmc-loopback"
```
